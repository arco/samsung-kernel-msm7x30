## drivers/dpram/Kconfig
```kconfig
# Dpram configuration
#

menu "Dpram support"

config DPRAM
       tristate "Using smem as dpram"
       default y
       ---help---
		Include this for using smem as dpram for communication between modem and appl.

config ENABLE_TTY_CIQ
       bool "Enabling dpram TTY CIQ Driver"
       default n
       ---help---
		Include this for using whitelist.

config DPRAM_WHITELIST
       bool "Using dpram to send whitelist port infos"
       default y
       ---help---
		Include this for using whitelist.

endmenu
```

## drivers/i2c/chips/Kconfig
```kconfig
#
# Miscellaneous I2C chip drivers configuration
#
# *** DEPRECATED! Do not add new entries! See Makefile ***
#

menu "Miscellaneous I2C Chip support"

config SENSORS_MT9T013
	tristate "MT9T013 Camera Driver"
	depends on I2C
	default y
	help
	 MT9T013 Camera Driver implemented by HTC.

config SENSORS_YDA165
	bool "YDA165 Audio Amp Driver"
	depends on I2C
	default n
	help
	 YDA165 Audio AMP	

endmenu
```

## drivers/input/touchscreen/ancora/Kconfig
```kconfig
if INPUT_TOUCHSCREEN

config TOUCHSCREEN_MELFAS_MCS8000
	bool "Melfas mcs8000 Touchscreen interface support"
	depends on I2C
        default n
        help
	  Say Y here to enable support for the Melfas
	  touchscreen controller.

config TOUCHSCREEN_MELFAS_FIRMWARE_UPDATE
	bool "melfas touchscreen firmware update"
	depends on TOUCHSCREEN_MELFAS_MCS8000 || TOUCHSCREEN_MELFAS
	default n
	help
	  Say Y here to enable the touchscreen firmware update.
	  Say N here to disable the touchscreen firmware update.

endif
```

## drivers/net/wireless/bcm4329/Kconfig
```kconfig
config BROADCOM_WIFI
	default m
	tristate "Broadcom WiFi Driver"
	---help---
		Select this option to build Broadcom wlan driver

config BROADCOM_WIFI_RESERVED_MEM
    bool "Samsung Multimedia Devices"
    depends on BROADCOM_WIFI
    default n
    ---help---
      This is a configuration for broadcom WLAN driver.

if BROADCOM_WIFI_RESERVED_MEM
config WLAN_SAMSUNG_MEMSIZE_BCM
    int "Memory size in kbytes for WLAN driver"
    default "256"
endif
```

## drivers/net/wireless/bcmdhd/Kconfig
```kconfig
config BCM4329
	tristate "---Broadcom WiFi Driver for 4329"
	depends on WLAN
	---help---
		Select this option to build Broadcom wlan driver

config BROADCOM_WIFI_RESERVED_MEM
	bool "BROADCOM Reserved memory for wifi device"
	depends on BCM4329
	---help---
		This is a configuration for broadcom WLAN driver.

config BROADCOM_WIFI
	bool "Broadcom WiFi Driver"
	depends on BCM4329
	default y
	---help---
		This is a configuration for broadcom WLAN driver.
```

## drivers/param/Kconfig
```kconfig
menu "Samsung Param support"
menuconfig MSM_PARAM
	tristate "Samsung Paramter Block system"
	depends on ARCH_MSM
	default	m
	help
	  Samsung EUROPA Android Phone - Parameter control driver
	  param.o
endmenu
```

## drivers/sensors_ancora/Kconfig
```kconfig
menu "Samsung Galaxy W sensor drivers"

config SENSORS_BMA023_ACCEL
	tristate "Bosch BMA023 Acceleration Sensor"
	depends on I2C

config INPUT_BMA023_POSITION
	int "BMA023 Mounting Position on Board"
	depends on SENSORS_BMA023_ACCEL
	default "0"
	help
	  Chip mounting position (pin 1).
	    0: top, upper-left
	    1: top, upper-right
	    2: top, lower-right
	    3: top, lower-left
	    4: bottom, upper-left
	    5: bottom, upper-right
	    6: bottom, lower-right
	    7: bottom, lower-left

config OPTICAL_GP2A
	depends on I2C
	tristate "GP2A driver"
	default n
	help
	  This option enables proximity & light sensors using gp2a driver.

config SENSORS_AK8975
	tristate "AK8975 compass support"
	default n
	depends on I2C
	help
	  If you say yes here you get support for Asahi Kasei's
	  orientation sensor AK8975.

endmenu
```

## drivers/sensors_ariesve/Kconfig
```kconfig
menu "Samsung Galaxy S Plus sensor drivers"

config SENSORS_BMA023_ACCEL
	tristate "Bosch BMA023 Acceleration Sensor"
	depends on I2C

config INPUT_BMA023_POSITION
	int "BMA023 Mounting Position on Board"
	depends on SENSORS_BMA023_ACCEL
	default "0"
	help
	  Chip mounting position (pin 1).
	    0: top, upper-left
	    1: top, upper-right
	    2: top, lower-right
	    3: top, lower-left
	    4: bottom, upper-left
	    5: bottom, upper-right
	    6: bottom, lower-right
	    7: bottom, lower-left

config SENSORS_YAS529_MAGNETIC
	tristate "Yamaha YAS529 Geomagnetic Sensor"
	depends on I2C

config INPUT_YAS529_POSITION
	int "YAS529 Mounting Position on Board"
	depends on SENSORS_YAS529_MAGNETIC
	default "0"
	help
	  Chip mounting position (pin 1).
	    0: top, upper-left
	    1: top, upper-right
	    2: top, lower-right
	    3: top, lower-left
	    4: bottom, upper-left
	    5: bottom, upper-right
	    6: bottom, lower-right
	    7: bottom, lower-left
	    
config SENSORS_ORIENTATION
	tristate "Yamaha Orientation Sensor"
	depends on I2C

config OPTICAL_GP2A
	depends on I2C
	tristate "GP2A driver"
	default n
	help
	  This option enables proximity & light sensors using gp2a driver.

endmenu
```
